## Kconfig
```kconfig
# SPDX-License-Identifier: MIT

menu "Piantor Pro BT"

config PIANTOR_BT_INDICATOR
    bool "Bluetooth profile indicator on the BT_SEL keys"
    default y
    depends on DT_HAS_PIANTOR_BT_INDICATOR_STRIP_ENABLED
    select LED_STRIP
    select SPI
    help
      While the Keyboard layer is held, the LEDs under the five BT_SEL keys
      show each profile's state, with the active one brightest. Everything
      else is left to the normal underglow effect. Implemented as a strip
      shim, so it only runs when underglow is already pushing a frame.

      Always built when the zmk,underglow chosen node is the shim, since
      something must back that node. Without ZMK_BLE (settings_reset) or
      ZMK_RGB_UNDERGLOW the parts that need them drop out and the shim is
      a plain pass-through.

if PIANTOR_BT_INDICATOR

config PIANTOR_BT_INDICATOR_LAYER
    int "Layer that shows the indicator"
    default 3

config PIANTOR_BT_INDICATOR_BRT_ACTIVE
    int "Brightness of the active profile's LED in percent"
    range 1 100
    default 60

config PIANTOR_BT_INDICATOR_BRT_INACTIVE
    int "Brightness of the other profiles' LEDs in percent"
    range 1 100
    default 25

config PIANTOR_BT_INDICATOR_OTHERS_PERCENT
    int "Brightness kept on the non-BT LEDs while the indicator shows, in percent"
    range 0 100
    default 100
    help
      100 leaves the underglow effect untouched around the indicator.
      Lower it if the indicator does not stand out enough against the effect.

config PIANTOR_BATTERY_INDICATOR
    bool "Also show both halves' battery level on the inner thumb keys"
    default y
    depends on ZMK_BATTERY_REPORTING && ZMK_BLE
    help
      Position 37 shows this half's battery, position 38 the right half's:
      green >= 80%, turquoise >= 60%, yellow >= 40%, orange >= 20%, red below.
      Dim white while the right half's level is not known yet.

config PIANTOR_BATTERY_CHARGE_INDICATOR
    bool "Show charging state on the battery LEDs while USB powered"
    default y
    depends on PIANTOR_BATTERY_INDICATOR && SOC_NRF52840
    help
      While a half is plugged into USB its battery LED pulses orange until
      the level reaches PIANTOR_BATTERY_FULL_PERCENT, then turns steady
      bright white. This half reads its own VBUS line and gauge. The right
      half's state arrives over the split link when PIANTOR_SPLIT_POWER is
      enabled (it is by default, but both halves must run firmware that has
      it); until then, or with it disabled, the right LED keeps showing the
      level.

if PIANTOR_BATTERY_CHARGE_INDICATOR

config PIANTOR_BATTERY_CHARGING_PULSE_MS
    int "Period of the charging pulse in ms (0 for steady orange)"
    range 0 10000
    default 2000

config PIANTOR_BATTERY_CHARGING_PULSE_MIN_PERCENT
    int "Dimmest point of the charging pulse, in percent of the active brightness"
    range 0 100
    default 20

endif # PIANTOR_BATTERY_CHARGE_INDICATOR

config PIANTOR_BT_INDICATOR_REFRESH_MS
    int "Refresh period while the layer is held and underglow is off, in ms"
    range 50 1000
    default 100
    help
      With underglow on, its own 50 ms frames carry the indicator and this
      timer is idle. With underglow off, the indicator draws itself at this
      rate so profile changes show up while the layer is held.

config PIANTOR_BT_INDICATOR_INIT_PRIORITY
    int "Init priority (must be after the wrapped LED strip)"
    default 91

endif # PIANTOR_BT_INDICATOR

config PIANTOR_BATTERY_FULL_PERCENT
    int "Level at which a USB powered half counts as fully charged"
    range 1 100
    default 100
    depends on ZMK_BATTERY_REPORTING && SOC_NRF52840
    help
      Used by both halves, each against its own gauge reading. The MAX17048
      estimates the level from cell voltage and normally reaches 100 around
      the time the charger tops off; its raw reading can even go a little
      above 100 on a full cell, which still counts. Lower this if a half
      sits at 99 while plugged in and never turns white.

config PIANTOR_SPLIT_POWER
    bool "Share the right half's charge state over the split link"
    default y
    depends on ZMK_SPLIT_BLE && ZMK_BATTERY_REPORTING && SOC_NRF52840
    help
      Built on both halves. The right half (peripheral) adds a GATT
      characteristic holding its charge state (on battery / charging /
      full, decided from its own VBUS line and gauge) and notifies on every
      change; the left half (central) subscribes to it, so the charging
      indicator can show the right half too. Nothing else depends on it.

if PIANTOR_SPLIT_POWER

config PIANTOR_SPLIT_POWER_POLL_MS
    int "How often the peripheral re-evaluates its charge state, in ms"
    range 100 10000
    default 1000
    help
      One register read per period; the value is only sent when it changes.

endif # PIANTOR_SPLIT_POWER

config PIANTOR_LED_CALIBRATION
    bool "LED chain calibration chase"
    select LED_STRIP
    select SPI
    select ZMK_LOW_PRIORITY_WORK_QUEUE
    help
      Lights one LED of the zmk,underglow strip at a time, walking the chain
      from index 0 upward and wrapping, so the physical key under each chain
      index can be recorded. The keymap is untouched. Build with
      CONFIG_ZMK_RGB_UNDERGLOW=n so the two never drive the strip at once.

if PIANTOR_LED_CALIBRATION

config PIANTOR_LED_CALIBRATION_STEP_MS
    int "Milliseconds each LED stays lit"
    range 250 10000
    default 2000

config PIANTOR_LED_CALIBRATION_BRIGHTNESS
    int "Per-channel brightness of the lit LED (0-255)"
    range 1 64
    default 24
    help
      Kept low on purpose: this writes raw pixel values and bypasses the
      underglow brightness cap. One LED at 24/255 white is a few mA.

endif # PIANTOR_LED_CALIBRATION

endmenu
```

## dts/bindings/led_strip/piantor,bt-indicator-strip.yaml
```yaml
# SPDX-License-Identifier: MIT

description: |
  LED strip shim that sits between ZMK's RGB underglow and the real strip.
  Frames pass through untouched, except while the configured layer is
  active, when the pixels under the BT_SEL keys are overwritten with the
  Bluetooth profile indicator. Point zmk,underglow at this node.

compatible: "piantor,bt-indicator-strip"

include: base.yaml

properties:
  led-strip:
    type: phandle
    required: true
    description: The physical LED strip to forward frames to.

  chain-length:
    type: int
    required: true
    description: Number of LEDs. Must match the wrapped strip; ZMK reads it from here.
```
